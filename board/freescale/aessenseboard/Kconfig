## board/freescale/aessenseboard/Kconfig
```kconfig
if TARGET_MX6AESSENSEBOARD

config SYS_BOARD
	default "aessenseboard"

config SYS_VENDOR
	default "freescale"

config SYS_CONFIG_NAME
	default "mx6aessenseboard"

endif
```

## configs/mx6dlaessenseboard_defconfig
```kconfig
CONFIG_ARM=y
CONFIG_ARCH_MX6=y
CONFIG_TARGET_MX6AESSENSEBOARD=y
CONFIG_SYS_EXTRA_OPTIONS="IMX_CONFIG=board/freescale/aessenseboard/mx6dlaessenseboard.cfg,MX6DL,SYS_USE_SPINOR"
CONFIG_CMD_GPIO=y
```
